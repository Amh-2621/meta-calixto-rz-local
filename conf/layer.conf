## conf/machine/include/rzg2l-calixto-family.inc
```bitbake
require conf/machine/include/soc-family.inc
SOC_FAMILY = "rzg2l-family:mali-family"

# Machine configuration
MACHINE_FEATURES = "opengles opencl"

IMAGE_FSTYPES:append = " tar.bz2 ext4"

# Configuration for ARM Trusted Firmware
EXTRA_IMAGEDEPENDS += " trusted-firmware-a-calixto-rz"

# flash writer
EXTRA_IMAGEDEPENDS += " flash-writer-calixto-rz"

# Firmware-pack
EXTRA_IMAGEDEPENDS += " firmware-pack-calixto-rz"

# U-boot
EXTRA_IMAGEDEPENDS += " u-boot-calixto-rz"
PREFERRED_PROVIDER_virtual/bootloader = "u-boot-calixto-rz"

# Linux kernel configuration
PREFERRED_PROVIDER_virtual/kernel ?= "linux-calixto"
PREFERRED_VERSION_linux-calixto ?= "6.1%"
```

## conf/machine/rzg2l-versa-1gb.conf
```bitbake
#@TYPE: Machine
#@NAME: rzg2l-versa-1gb machine
#@DESCRIPTION: RZ/G2L CALIXTO VERSA

require conf/machine/include/arm/armv8-2a/tune-cortexa55.inc
require conf/machine/include/rz-common.inc
require conf/machine/include/rzg2l-calixto-family.inc

# Trusted Firmware-A configuration
PREFERRED_VERSION_trusted-firmware-a-calixto-rz ?= "2.9%"
TFA_PLATFORM ?= "g2l"
TFA_BOARD ?= "BOARD=CALIXTO_RZG2L_VERSA_1GB"
TFA_UBOOT ?= "1"
TFA_BUILD_TARGET ?= "bl2 bl31 fip"
BL2_BOOT_TARGET ?= "spi mmc esd"
BL2_ADJUST_VMA ?= "0x00011E00"
FIP_ADJUST_VMA ?= "0x0000"

# U-Boot Configuration
UBOOT_CONFIG ??= "rzg2l-versa-1gb"
UBOOT_CONFIG[rzg2l-versa-1gb] = "rzg2l_calixto_versa_1GB_defconfig"
PREFERRED_VERSION_u-boot-calixto-rz = "2021.10%"

IMAGE_FSTYPES:remove = " tar.bz2 tar.gz"
IMAGE_FSTYPES:append = " tar"

KERNEL_IMAGETYPE ?= "Image"
KERNEL_DEVICETREE ?= " \
        renesas/rzg2l-calixto-versa.dtb \
"

IMAGE_INSTALL:append=" kernel kernel-devicetree"

# Flash Writer configuration
FLASH_WRITER_BOARD ?= "RZG2L_VERSA_SOM_1GB"
FLASH_WRITER_PMIC_BOARD ?= "RZG2L_SMARC_PMIC"

IMAGE_BOOT_FILES = " \
        bl2_bp-${MACHINE}.bin \
        fip-${MACHINE}.bin \
        bl2_bp-${MACHINE}.srec \
        fip-${MACHINE}.srec \
        Flash_Writer_SCIF_RZG2L_VERSA_SOM_DDR4_1GB_1PCS.mot \
"
do_image_wic[depends] += "firmware-pack-calixto-rz:do_deploy flash-writer-calixto-rz:do_deploy"

MACHINE_FEATURES:append = " mali-g31 hwh264dec hwh264enc"

require create-calixto-image.inc
IMAGE_POSTPROCESS_COMMAND += "create_rz_image; "
```

## conf/machine/rzg2ul-tiny-256mb.conf
```bitbake
#@TYPE: Machine
#@NAME: rzg2ul-tiny-256mb machine
#@DESCRIPTION: RZ/G2UL CALIXTO TINY

require conf/machine/include/arm/armv8-2a/tune-cortexa55.inc
require conf/machine/include/rz-common.inc
require conf/machine/include/rzg2l-calixto-family.inc

# Trusted Firmware-A configuration
PREFERRED_VERSION_trusted-firmware-a-calixto-rz ?= "2.9%"
TFA_PLATFORM ?= "g2ul"
TFA_BOARD ?= "BOARD=CALIXTO_RZG2UL_TINY_256MB DEVICE_TYPE=2"
TFA_UBOOT ?= "1"
TFA_BUILD_TARGET ?= "bl2 bl31 fip"
BL2_BOOT_TARGET ?= "spi mmc esd"
BL2_ADJUST_VMA ?= "0x00011E00"
FIP_ADJUST_VMA ?= "0x0000"

# U-Boot Configuration
UBOOT_CONFIG ??= "rzg2ul-tiny-256mb"
UBOOT_CONFIG[rzg2ul-tiny-256mb] = " rzg2ul_calixto_tiny_256MB_defconfig"
PREFERRED_VERSION_u-boot-calixto-rz = "2021.10%"

# Flash Writer configuration
FLASH_WRITER_BOARD ?= "RZG2UL_TINY_SOM_256MB"

MACHINE_FEATURES:remove = "opengles opencl"

IMAGE_FSTYPES:remove = " tar.bz2 tar.gz"
IMAGE_FSTYPES:append = " tar"

KERNEL_IMAGETYPE ?= "Image"
KERNEL_DEVICETREE ?= " \
        renesas/rzg2ul-calixto-tiny.dtb \
"
IMAGE_INSTALL:append=" kernel kernel-devicetree"

IMAGE_BOOT_FILES = " \
        bl2_bp-${MACHINE}.bin \
        fip-${MACHINE}.bin \
        bl2_bp-${MACHINE}.srec \
        fip-${MACHINE}.srec \
        Flash_Writer_SCIF_RZG2UL_TINY_SOM_DDR3L_256MB_1PCS.mot \
"
do_image_wic[depends] += "firmware-pack-calixto-rz:do_deploy flash-writer-calixto-rz:do_deploy"

require create-calixto-image.inc
IMAGE_POSTPROCESS_COMMAND += "create_rz_image; "
```
